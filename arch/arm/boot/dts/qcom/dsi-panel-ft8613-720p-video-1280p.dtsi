/* Copyright (C) 2017 Tcl Corporation Limited */
/* Copyright (c) 2015, The Linux Foundation. All rights reserved.
 *
 * This program is free software; you can redistribute it and/or modify
 * it under the terms of the GNU General Public License version 2 and
 * only version 2 as published by the Free Software Foundation.
 *
 * This program is distributed in the hope that it will be useful,
 * but WITHOUT ANY WARRANTY; without even the implied warranty of
 * MERCHANTABILITY or FITNESS FOR A PARTICULAR PURPOSE.  See the
 * GNU General Public License for more details.
 */

/*---------------------------------------------------------------------------
 * This file is autogenerated file using gcdb parser. Please do not edit it.
 * Update input XML file to add a new entry or update variable in this file
 * VERSION = "1.0"
 *---------------------------------------------------------------------------*/
&mdss_mdp {
	dsi_ft8613_720_video_1280p: qcom,mdss_dsi_ft8613_720p_video_1280p {
/*modified by yjw,for compatible tp,bug-5653823 ,begin*/
		qcom,mdss-dsi-panel-name = "ft8613 1280p video mode dsi panel[20180614_v2]";
/*modified by yjw,for compatible tp,bug-5653823 ,end*/
		qcom,mdss-dsi-panel-type = "dsi_video_mode";
		/* MODIFIED-BEGIN by junwen.ye, 2017-11-29,BUG-5628800*/
		qcom,mdss-dsi-panel-framerate = <60>;
		qcom,mdss-dsi-virtual-channel-id = <0>;
		qcom,mdss-dsi-stream = <0>;
		qcom,mdss-dsi-panel-width = <720>;
		qcom,mdss-dsi-panel-height = <1280>;  /* change to 1920 for BOE standard panel */
		qcom,mdss-pan-physical-width-dimension = <41>;  /* 435 px/inch = (1080 px / 63mm) * 25.4 mm/inch  */
		qcom,mdss-pan-physical-height-dimension = <73>; /* 435 px/inch = (1620 px / 95mm) * 25.4 mm/inch  */
//modify begin by yusen.ke.sz for fix lcm flash on 20180914
		qcom,mdss-dsi-h-front-porch = <108>;//modify by yusen.ke.sz@tcl.com at 20180326 for RF request
		qcom,mdss-dsi-h-back-porch = <108>;//modify by yusen.ke.sz@tcl.com at 20180326 for RF request
		qcom,mdss-dsi-h-pulse-width = <4>;
//modify end by yusen.ke.sz for fix lcm flash on 20180914
		qcom,mdss-dsi-h-sync-skew = <0>;
		qcom,mdss-dsi-v-back-porch = <16>;
		qcom,mdss-dsi-v-front-porch = <16>;
		/* MODIFIED-END by junwen.ye,BUG-5628800*/
		qcom,mdss-dsi-v-pulse-width = <2>;
		qcom,mdss-dsi-h-left-border = <0>;
		qcom,mdss-dsi-h-right-border = <0>;
		qcom,mdss-dsi-v-top-border = <0>;
		qcom,mdss-dsi-v-bottom-border = <0>;
		qcom,mdss-dsi-bpp = <24>;
		qcom,mdss-dsi-underflow-color = <0xff>;
		qcom,mdss-dsi-border-color = <0>;
		qcom,mdss-dsi-on-command = [
			15 01 00 00 00 00 02 00 00
			39 01 00 00 00 00 04 ff 87 16 01
			15 01 00 00 00 00 02 00 80
			39 01 00 00 00 00 03 ff 87 16
			15 01 00 00 00 00 02 00 80
			39 01 00 00 00 00 10 C0 00 B4 00 10 10 00 B4 10 10 00 B4 00 10 10 00
			15 01 00 00 00 00 02 00 A0
			39 01 00 00 00 00 08 C0 00 02 02 10 01 25 0A
			15 01 00 00 00 00 02 00 D0
			39 01 00 00 00 00 08 C0 00 02 02 10 01 25 0A
			15 01 00 00 00 00 02 00 82
			39 01 00 00 00 00 0A A5 33 02 0C 00 00 00 07 77 77
			15 01 00 00 00 00 02 00 80
			39 01 00 00 00 00 05 C2 84 02 5A E5
			15 01 00 00 00 00 02 00 E0
			39 01 00 00 00 00 05 C2 02 01 0A 0A
			15 01 00 00 00 00 02 00 F4
			39 01 00 00 00 00 06 C2 85 05 06 30 00
			15 01 00 00 00 00 02 00 B0
			39 01 00 00 00 00 10 C2 84 01 00 0B 81 83 02 00 0B 81 82 03 00 0B 81
			15 01 00 00 00 00 02 00 C0
			39 01 00 00 00 00 06 C2 81 04 00 0B 81
			15 01 00 00 00 00 02 00 DA
			39 01 00 00 00 00 03 C2 33 33
			15 01 00 00 00 00 02 00 AA
			39 01 00 00 00 00 03 C3 39 9C
			15 01 00 00 00 00 02 00 D0
			39 01 00 00 00 00 0E C3 00 0A 0A 00 00 00 00 01 04 00 5A 00 00
			15 01 00 00 00 00 02 00 E0
			39 01 00 00 00 00 0E C3 00 0A 0A 00 00 00 00 01 04 00 5A 00 00
			15 01 00 00 00 00 02 00 80
			39 01 00 00 00 00 07 CE 25 00 68 00 78 FF
			15 01 00 00 00 00 02 00 89
			15 01 00 00 00 00 02 CE C8
			15 01 00 00 00 00 02 00 90
			39 01 00 00 00 00 09 CE 00 5c 0D 9B 00 5c 00 06
			15 01 00 00 00 00 02 00 A1
			39 01 00 00 00 00 08 CE 00 06 00 00 01 01 01
			15 01 00 00 00 00 02 00 80
			39 01 00 00 00 00 0D CC 02 24 10 01 06 07 08 09 20 21 24 24
			15 01 00 00 00 00 02 00 90
			39 01 00 00 00 00 0D CC 10 24 02 01 09 08 07 06 20 21 24 24
			15 01 00 00 00 00 02 00 A0
			39 01 00 00 00 00 10 CC 1A 1B 1C 1D 1E 1F 18 19 14 15 24 24 24 24 24
			15 01 00 00 00 00 02 00 B0
			39 01 00 00 00 00 06 CC 24 24 24 24 24
			15 01 00 00 00 00 02 00 80
			39 01 00 00 00 00 09 CB 00 00 00 C0 30 0C 03 00
			15 01 00 00 00 00 02 00 90
			39 01 00 00 00 00 10 CB 00 00 00 C0 00 00 00 00 00 FF 00 00 00 00 00
			15 01 00 00 00 00 02 00 A0
			39 01 00 00 00 00 10 CB 00 00 00 00 00 00 00 00 00 00 00 00 00 00 00
			15 01 00 00 00 00 02 00 B0
			39 01 00 00 00 00 03 CB 00 00
			15 01 00 00 00 00 02 00 C0
			39 01 00 00 00 00 10 CB 15 00 15 2A 15 15 15 15 2A D5 00 00 15 15 15
			15 01 00 00 00 00 02 00 D0
			39 01 00 00 00 00 10 CB 15 15 15 55 55 00 00 00 00 00 00 00 00 00 00
			15 01 00 00 00 00 02 00 E0
			39 01 00 00 00 00 03 CB 00 00
			15 01 00 00 00 00 02 00 F0
			39 01 00 00 00 00 09 CB F3 FF 0F 3F F0 0C 00 00
			15 01 00 00 00 00 02 00 80
			39 01 00 00 00 00 10 CD 01 03 13 14 04 16 16 06 08 09 15 0A 0D 0D 0E
			15 01 00 00 00 00 02 00 90
			39 01 00 00 00 00 04 CD 0E 0F 0F
			15 01 00 00 00 00 02 00 A0
			39 01 00 00 00 00 10 CD 01 03 13 14 04 16 16 05 07 09 22 0A 0D 0D 0E
			15 01 00 00 00 00 02 00 B0
			39 01 00 00 00 00 04 CD 0E 0F 0F
			15 01 00 00 00 00 02 00 81
			39 01 00 00 00 00 0D F3 FF F3 C0 FF F3 C0 00 02 00 00 02 00
			15 01 00 00 00 00 02 00 86
			/* MODIFIED-BEGIN by junwen.ye, 2017-12-05,BUG-5628800*/
			15 01 00 00 00 00 02 b0 0b
			15 01 00 00 00 00 02 00 C0
			15 01 00 00 00 00 02 C0 01
			15 01 00 00 00 00 02 00 8C
			39 01 00 00 00 00 03 f5 15 21
			15 01 00 00 00 00 02 00 a0
			39 01 00 00 00 00 08 b3 03 02 D0 05 00 00 50
			15 01 00 00 00 00 02 00 00
			39 01 00 00 00 00 05 2A 00 00 02 CF
			15 01 00 00 00 00 02 00 00
			39 01 00 00 00 00 05 2B 00 00 04 FF
			15 01 00 00 00 00 02 00 90
			39 01 00 00 00 00 08 b0 09 09 05 08 08 04 29
			15 01 00 00 00 00 02 00 80
			39 01 00 00 00 00 0B c5 00 c1 dd c4 14 1e 00 55 50 04
			15 01 00 00 00 00 02 00 90
			39 01 00 00 00 00 0B c5 77 19 1E 00 88 01 28 50 55 50
			15 01 00 00 00 00 02 00 88
			39 01 00 00 00 00 03 c3 22 22
			15 01 00 00 00 00 02 00 98
			39 01 00 00 00 00 03 c3 22 22
			15 01 00 00 00 00 02 00 90
			39 01 00 00 00 00 05 CF FF 00 FE 00
			15 01 00 00 00 00 02 00 94
			39 01 00 00 00 00 05 CF 00 00 10 20
			15 01 00 00 00 00 02 00 A4
			39 01 00 00 00 00 05 CF 00 07 01 80
			15 01 00 00 00 00 02 00 d0
			15 01 00 00 00 00 02 CF 08
			/*15 01 00 00 00 00 02 00 00
			39 01 00 00 00 00 06 D9 80 B4 B4 B4 B4*///del by yusen.ke.sz@tcl.com at 20180306 for FAE REQ
			15 01 00 00 00 00 02 00 00
			39 01 00 00 00 00 03 D8 21 21
//modify by yusen.ke.sz@tcl.com at 20180814 for update gamma 
			

15 01 00 00 00 00 02 00 00
39 01 00 00 00 00 19 E1 07 10 24 37 41 4D 5D 69 6E 75 7B 81 79 74 72 6C 5D 51 41 37 2E 1F 11 12
15 01 00 00 00 00 02 00 00
39 01 00 00 00 00 19 E2 01 10 24 37 41 4D 5D 69 6E 75 7B 81 79 74 72 6C 5D 51 41 37 2E 1F 11 08
//modify end
			/* MODIFIED-END by junwen.ye,BUG-5628800*/

15 01 00 00 00 00 02 00 01                                                                                                               
15 01 00 00 00 00 02 C6 10                                                                                                               
15 01 00 00 00 00 02 00 00                                                                                                               
39 01 00 00 00 00 13 C8 90 78 56 34 33 33 33 33 33 33 43 44 43 44 44 44 44 54//Default Low                                                                                                                                                  
15 01 00 00 00 00 02 00 01                                                                                                               
15 01 00 00 00 00 02 C6 11                                                                                                               
15 01 00 00 00 00 02 00 00                                                                                                               
39 01 00 00 00 00 13 C8 90 78 56 34 33 33 22 33 33 43 44 44 43 44 44 44 44 54 //Default Low + modify1                                                                                                                                                
15 01 00 00 00 00 02 00 01                                                                                                               
15 01 00 00 00 00 02 C6 12                                                                                                               
15 01 00 00 00 00 02 00 00                                                                                                                                    
39 01 00 00 00 00 13 C8 E0 8C 56 33 33 33 33 33 33 33 23 22 33 43 44 44 44 44   //HIGH
15 01 00 00 00 00 02 00 01                                                                                                               
15 01 00 00 00 00 02 C6 00
15 01 00 00 00 00 02 00 00                                                                                                               
15 01 00 00 00 00 02 92 00
//add by yusen.ke.sz@tcl.com at 20180620 for 2nd lcd bringup begin
15 01 00 00 00 00 02 00 90
15 01 00 00 00 00 02 B3 01
15 01 00 00 00 00 02 00 92
15 01 00 00 00 00 02 B3 40
//add by yusen.ke.sz@tcl.com at 20180620 for 2nd lcd bringup end                          
			05 01 00 00 78 00 02 11 00	//delayms_pc(200);
			//15 01 00 00 00 00 02 35 00 // MODIFIED by junwen.ye, 2017-10-30,turn off TE,BUG-5424229
			05 01 00 00 14 00 02 29 00	//delayms_pc(100);
			];
		qcom,mdss-dsi-off-command = [
			05 01 00 00 14 00 02 28 00
			05 01 00 00 78 00 02 10 00];
		qcom,mdss-dsi-on-command-state = "dsi_lp_mode";
		qcom,mdss-dsi-off-command-state = "dsi_hs_mode";
		qcom,mdss-dsi-h-sync-pulse = <1>;
		qcom,mdss-dsi-traffic-mode = "burst_mode";
		qcom,mdss-dsi-bllp-eof-power-mode;
		qcom,mdss-dsi-bllp-power-mode;
		qcom,mdss-dsi-lane-0-state;
		qcom,mdss-dsi-lane-1-state;
		qcom,mdss-dsi-lane-2-state;
		qcom,mdss-dsi-lane-3-state;
		/* MODIFIED-BEGIN by junwen.ye, 2017-11-29,BUG-5628800*/
		//qcom,mdss-dsi-panel-timings = [7d 18 10 00 3a 3e
		//	12 1a 13 03 04 00];
//modify begin by yusen.ke.sz for fix lcm flash on 20180914
qcom,mdss-dsi-panel-timings = [7f 1c 12 00 40 44 16 1e 17 03 04 00];
//modify end by yusen.ke.sz for fix lcm flash on 20180914
		//qcom,mdss-dsi-panel-timings-phy-v2 = [22 1E 07 08 04 03 04 a0
		//22 1E 07 08 04 03 04 a0
               	//22 1E 07 08 04 03 04 a0
               	//22 1E 07 08 04 03 04 a0
               	//22 17 07 08 04 03 04 a0];
		qcom,mdss-dsi-t-clk-post = <0x04>;
//modify begin by yusen.ke.sz for fix lcm flash on 20180914
		qcom,mdss-dsi-t-clk-pre = <0x1b>;
//modify end by yusen.ke.sz for fix lcm flash on 20180914
		/* MODIFIED-END by junwen.ye,BUG-5628800*/
		qcom,mdss-dsi-bl-min-level = <1>;
		qcom,mdss-dsi-bl-max-level = <4095>;
		qcom,mdss-dsi-dma-trigger = "trigger_sw";
		qcom,mdss-dsi-mdp-trigger = "none";
		qcom,mdss-dsi-bl-pmic-control-type = "bl_ctrl_wled";
		qcom,mdss-dsi-reset-sequence = <1 20>, <0 6>, <1 120>;//modify by yusen.ke.sz@tcl.com at 20171211 for Optimization of resume time 
		qcom,esd-check-enabled;
		qcom,mdss-dsi-panel-status-command = [06 01 00 01 05 00 01 0A];
		qcom,mdss-dsi-panel-status-command-mode = "dsi_lp_mode";
		qcom,mdss-dsi-panel-status-check-mode = "reg_read";
		qcom,mdss-dsi-panel-status-read-length = <1 1 1>;
		qcom,mdss-dsi-panel-status-value = <0x9C 0x00 0x00>;
		qcom,mdss-dsi-panel-max-error-count = <3>;
		//qcom,mdss-dsi-panel-clockrate = <368809440>;
	};
};
