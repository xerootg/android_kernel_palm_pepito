/* Copyright (C) 2017 Tcl Corporation Limited */
/* Copyright (c) 2015, The Linux Foundation. All rights reserved.
 *
 * This program is free software; you can redistribute it and/or modify
 * it under the terms of the GNU General Public License version 2 and
 * only version 2 as published by the Free Software Foundation.
 *
 * This program is distributed in the hope that it will be useful,
 * but WITHOUT ANY WARRANTY; without even the implied warranty of
 * MERCHANTABILITY or FITNESS FOR A PARTICULAR PURPOSE.  See the
 * GNU General Public License for more details.
 */

/*---------------------------------------------------------------------------
 * This file is autogenerated file using gcdb parser. Please do not edit it.
 * Update input XML file to add a new entry or update variable in this file
 * VERSION = "1.0"
 *---------------------------------------------------------------------------*/
&mdss_mdp {
	dsi_ft8613_720_video: qcom,mdss_dsi_ft8613_720p_video {
		qcom,mdss-dsi-panel-name = "ft8613 720p video mode dsi panel[20171211_v1]";
		qcom,mdss-dsi-panel-type = "dsi_video_mode";
		qcom,mdss-dsi-panel-framerate = <60>;
		qcom,mdss-dsi-virtual-channel-id = <0>;
		qcom,mdss-dsi-stream = <0>;
		qcom,mdss-dsi-panel-width = <720>;
		qcom,mdss-dsi-panel-height = <1440>;  /* change to 1920 for BOE standard panel */
		qcom,mdss-pan-physical-width-dimension = <42>;  /* 435 px/inch = (1080 px / 63mm) * 25.4 mm/inch  */
		qcom,mdss-pan-physical-height-dimension = <84>; /* 435 px/inch = (1620 px / 95mm) * 25.4 mm/inch  */
		qcom,mdss-dsi-h-front-porch = <32>;
		qcom,mdss-dsi-h-back-porch = <32>;
		qcom,mdss-dsi-h-pulse-width = <4>;
		qcom,mdss-dsi-h-sync-skew = <0>;
		qcom,mdss-dsi-v-back-porch = <16>;
		qcom,mdss-dsi-v-front-porch = <16>;
		qcom,mdss-dsi-v-pulse-width = <4>;
		qcom,mdss-dsi-h-left-border = <0>;
		qcom,mdss-dsi-h-right-border = <0>;
		qcom,mdss-dsi-v-top-border = <0>;
		qcom,mdss-dsi-v-bottom-border = <0>;
		qcom,mdss-dsi-bpp = <24>;
		qcom,mdss-dsi-underflow-color = <0xff>;
		qcom,mdss-dsi-border-color = <0>;
		qcom,mdss-dsi-on-command = [

			15 01 00 00 01 00 02 00 00
			39 01 00 00 01 00 04 ff 87 16 01
			15 01 00 00 01 00 02 00 80
			39 01 00 00 01 00 03 ff 87 16
			15 01 00 00 01 00 02 00 80
			39 01 00 00 01 00 10 c0 00 a5 00 10 10 00 a5 10 10 00 a5 00 10 10 00
			15 01 00 00 01 00 02 00 80
			15 01 00 00 01 00 02 f3 70
			15 01 00 00 00 00 02 00 90
			15 01 00 00 00 00 02 c5 55
			15 01 00 00 00 00 02 00 a0
			39 01 00 00 00 00 08 c0 0d 01 01 01 01 24 09
			//39 01 00 00 00 00 02 00 b4
			//39 01 00 00 00 00 02 c0 50	//反扫
			15 01 00 00 00 00 02 00 D0
			39 01 00 00 00 00 08 c0 0d 01 01 01 01 24 09
			15 01 00 00 00 00 02 00 a8
			15 01 00 00 00 00 02 f5 22
			15 01 00 00 00 00 02 00 82
			39 01 00 00 00 00 04 a5 00 00 0c
			15 01 00 00 00 00 02 00 87
			39 01 00 00 00 00 05 a5 00 07 77 00
			15 01 00 00 00 00 02 00 a0
			39 01 00 00 00 00 09 ce 00 05 01 01 01 01 3f 0a
			15 01 00 00 00 00 02 00 a0
			15 01 00 00 00 00 02 b3 32
			15 01 00 00 00 00 02 00 a6
			15 01 00 00 00 00 02 b3 58
			//------GOA-------
//vst
			15 01 00 00 00 00 02 00 80
			39 01 00 00 00 00 0d c2 82 00 00 81 81 00 00 81 83 00 3f b0
//ckv
			15 01 00 00 00 00 02 00 b0
			39 01 00 00 00 00 10 c2 82 00 00 07 88 81 01 00 07 88 00 02 00 07 88
			15 01 00 00 00 00 02 00 c0
			39 01 00 00 00 00 06 c2 01 03 00 07 88
// CKV period
			15 01 00 00 00 00 02 00 da
			39 01 00 00 00 00 03 c2 33 33
// CKH BP FB
			15 01 00 00 00 00 02 00 82
			39 01 00 00 00 00 04 a5 00 00 00
// CKH TP term
			15 01 00 00 00 00 02 00 87
			39 01 00 00 00 00 05 a5 00 07 77 77
// EQ function
			15 01 00 00 00 00 02 00 88
			39 01 00 00 00 00 03 c3 22 22
			15 01 00 00 00 00 02 00 98
			39 01 00 00 00 00 03 c3 22 22
// CKV TP ctrl
			15 01 00 00 00 00 02 00 aa
			39 01 00 00 00 00 03 c3 99 9c
			15 01 00 00 00 00 02 00 90
			15 01 00 00 00 00 02 c5 55
			//----- tcon TP setting -----

			15 01 00 00 00 00 02 00 80
			39 01 00 00 00 00 0a ce 25 00 74 00 78 ff 00 00 05
			15 01 00 00 00 00 02 00 90
			39 01 00 00 00 00 09 ce 00 5c 0c e4 00 5c 00 00
			15 01 00 00 00 00 02 00 b0
			39 01 00 00 00 00 07 ce 00 00 60 60 00 60
			//----- panel interface -----
			15 01 00 00 00 00 02 00 c0
			39 01 00 00 00 00 03 f4 93 36


			15 01 00 00 00 00 02 00 80
			39 01 00 00 00 00 0d cc 02 03 06 07 08 09 0a 0b 0c 0d 0e 0f
			15 01 00 00 00 00 02 00 90
			39 01 00 00 00 00 0d cc 03 02 09 08 07 06 0f 0e 0d 0c 0b 0a
			15 01 00 00 00 00 02 00 a0
			39 01 00 00 00 00 10 cc 1a 1b 1c 1d 1e 1f 18 19 20 21 14 15 16 17 04
			15 01 00 00 00 00 02 00 b0
			39 01 00 00 00 00 06 cc 22 22 22 22 22
			15 01 00 00 00 00 02 00 80
			39 01 00 00 00 00 09 CB 00 00 00 00 00 00 00 00
			15 01 00 00 00 00 02 00 90
			39 01 00 00 00 00 10 CB 00 00 00 00 00 00 00 00 00 00 00 00 00 00 00
			15 01 00 00 00 00 02 00 a0
			39 01 00 00 00 00 10 CB 00 00 00 00 00 00 00 00 00 00 00 00 00 00 00
			15 01 00 00 00 00 02 00 b0
			39 01 00 00 00 00 03 cb 00 00
			15 01 00 00 00 00 02 00 c0
			39 01 00 00 00 00 10 CB 05 05 05 05 05 05 00 00 00 00 00 00 05 05 05
			15 01 00 00 00 00 02 00 d0
			39 01 00 00 00 00 10 CB 00 00 00 05 05 00 00 00 00 00 00 0A 00 00 00
			15 01 00 00 00 00 02 00 e0
			39 01 00 00 00 00 03 cb 00 00
			15 01 00 00 00 00 02 00 f0
			39 01 00 00 00 00 09 CB FF 0F 00 3F 30 30 30 00
			15 01 00 00 00 00 02 00 80
			39 01 00 00 00 00 10 CD 22 22 22 22 22 01 13 14 1B 05 03 17 18 18 22
			15 01 00 00 00 00 02 00 90
			39 01 00 00 00 00 04 cd 0f 0e 0d
			15 01 00 00 00 00 02 00 a0
			39 01 00 00 00 00 10 CD 22 22 22 22 22 02 13 14 1B 06 04 17 18 18 22
			15 01 00 00 00 00 02 00 b0
			39 01 00 00 00 00 04 cd 0f 0e 0d
			15 01 00 00 00 00 02 00 81
			39 01 00 00 00 00 0d F3 40 01 00 40 01 00 40 01 00 40 01 00
			//----- other -----
			15 01 00 00 00 00 02 00 00
			39 01 00 00 00 00 19 E1 00 06 18 2a 36 41 54 63 6a 72 7d 87 70 68 65 5e 51 45 37 2d 25 16 08 07
			15 01 00 00 00 00 02 00 00
			39 01 00 00 00 00 19 E2 00 06 18 2a 36 41 54 63 6a 72 7d 87 70 68 65 5e 51 45 37 2d 25 16 08 07
			15 01 00 00 00 00 02 00 80
			39 01 00 00 00 00 0b C5 00 C1 DD C4 14 1E 00 55 50 05
			15 01 00 00 00 00 02 00 90
			39 01 00 00 00 00 0b C5 77 1E 14 00 88 10 4C 53 55 50
			15 01 00 00 00 00 02 00 00
			39 01 00 00 00 00 03 d8 31 31
			15 01 00 00 00 00 02 00 00
			39 01 00 00 00 00 06 d9 80 be be be be
			15 01 00 00 00 00 02 00 d1
			39 01 00 00 00 00 0d cf 02 04 00 0A 00 14 02 04 00 0C 00 12
			15 01 00 00 00 00 02 00 c0
			39 01 00 00 00 00 03 c0 11 11
//For 720x1440
			15 01 00 00 00 00 02 00 00
			39 01 00 00 00 00 05 2a 00 00 02 cf
			15 01 00 00 00 00 02 00 00
			39 01 00 00 00 00 05 2b 00 00 05 9f
			15 01 00 00 00 00 02 00 a1
			39 01 00 00 00 00 05 b3 02 d0 05 a0
//add vcom pull GND
			15 01 00 00 00 00 02 00 00

			15 01 00 00 00 00 02 00 8d
			15 01 00 00 00 00 02 f5 21
//CMD2 DISABLE
			15 01 00 00 00 00 02 00 b4
			15 01 00 00 00 00 02 c0 50



			05 01 00 00 78 00 02 11 00	//delayms_pc(200);
			//15 01 00 00 00 00 02 35 00 // MODIFIED by junwen.ye, 2017-10-30,turn off TE,BUG-5424229
			05 01 00 00 14 00 02 29 00	//delayms_pc(100);
			];
		qcom,mdss-dsi-off-command = [
			05 01 00 00 14 00 02 28 00
			05 01 00 00 78 00 02 10 00];
		qcom,mdss-dsi-on-command-state = "dsi_lp_mode";
		qcom,mdss-dsi-off-command-state = "dsi_hs_mode";
		qcom,mdss-dsi-h-sync-pulse = <1>;
		qcom,mdss-dsi-traffic-mode = "burst_mode";
		qcom,mdss-dsi-bllp-eof-power-mode;
		qcom,mdss-dsi-bllp-power-mode;
		qcom,mdss-dsi-lane-0-state;
		qcom,mdss-dsi-lane-1-state;
		qcom,mdss-dsi-lane-2-state;
		qcom,mdss-dsi-lane-3-state;
		qcom,mdss-dsi-panel-timings = [7b 1a 10 00 3e 40
			16 1e 15 03 04 00];
		//qcom,mdss-dsi-panel-timings-phy-v2 = [22 1E 07 08 04 03 04 a0
		//22 1E 07 08 04 03 04 a0
               	//22 1E 07 08 04 03 04 a0
               	//22 1E 07 08 04 03 04 a0
               	//22 17 07 08 04 03 04 a0];
		qcom,mdss-dsi-t-clk-post = <0x04>;
		qcom,mdss-dsi-t-clk-pre = <0x1a>;
		qcom,mdss-dsi-bl-min-level = <1>;
		qcom,mdss-dsi-bl-max-level = <4095>;
		qcom,mdss-dsi-dma-trigger = "trigger_sw";
		qcom,mdss-dsi-mdp-trigger = "none";
		qcom,mdss-dsi-bl-pmic-control-type = "bl_ctrl_wled";
		qcom,mdss-dsi-reset-sequence = <1 20>, <0 6>, <1 120>;//modify by yusen.ke.sz@tcl.com at 20171211 for Optimization of resume time 
		qcom,esd-check-enabled;
		qcom,mdss-dsi-panel-status-command = [06 01 00 01 05 00 01 0A];
		qcom,mdss-dsi-panel-status-command-mode = "dsi_lp_mode";
		qcom,mdss-dsi-panel-status-check-mode = "reg_read";
		qcom,mdss-dsi-panel-status-read-length = <1 1 1>;
		qcom,mdss-dsi-panel-status-value = <0x9C 0x00 0x00>;
		qcom,mdss-dsi-panel-max-error-count = <3>;
	};
};
